/**
 ******************************************************************************
 * @file    ads131m08.c
 * @brief   Driver for ADS131M08 8-channel 24-bit ADC.
 *
 * Peripheral configuration is done entirely through registers using the
 * definitions provided by the STM32F4 HAL headers (no HAL_xxx_Init calls).
 *
 * SPI2 pins (hardwired alternate-function, cannot be changed in software):
 *   PB13 — SCK  (AF5)
 *   PB14 — MISO (AF5)
 *   PB15 — MOSI (AF5)
 *
 * CLKIN is generated by TIM2 PWM on the pin stored in dev->clkin_port/pin
 * (default PA0, TIM2 CH1, AF1).
 *
 * CS / RST / DRDY — arbitrary GPIO, configured as outputs / input by this
 * driver according to the port/pin fields in ADS131M08_t.
 ******************************************************************************
 */

#include "ads131m08.h"

/* Timeout for blocking DRDY wait, in HAL tick units (milliseconds) */
#define DRDY_TIMEOUT_MS 50u

/* -------------------------------------------------------------------------
 * GPIO helpers
 * ------------------------------------------------------------------------- */

static inline void cs_low(const ADS131M08_t *dev) {
  dev->cs_port->BSRR = (uint32_t)dev->cs_pin << 16u; /* reset = drive low */
}

static inline void cs_high(const ADS131M08_t *dev) {
  dev->cs_port->BSRR = dev->cs_pin; /* set = drive high */
}

static inline void rst_low(const ADS131M08_t *dev) {
  dev->rst_port->BSRR = (uint32_t)dev->rst_pin << 16u;
}

static inline void rst_high(const ADS131M08_t *dev) {
  dev->rst_port->BSRR = dev->rst_pin;
}

/* Returns true while DRDY pin is high (no data ready yet).
   DRDY is active-low: the chip pulls it low when a conversion is available. */
static inline bool drdy_is_high(const ADS131M08_t *dev) {
  return (dev->drdy_port->IDR & dev->drdy_pin) != 0u;
}

/* -------------------------------------------------------------------------
 * SPI2 low-level byte exchange
 * ------------------------------------------------------------------------- */

/**
 * @brief  Exchange one byte on SPI2 (blocking, polled TXE/RXNE).
 *
 * The ADS131M08 uses 24-bit words, so all transfers are built from three
 * consecutive byte exchanges while CS is held low.
 */
static uint8_t spi_xfer_byte(uint8_t tx) {
  /* Wait for TX buffer empty */
  while (!(SPI2->SR & SPI_SR_TXE)) {
  }
  *(__IO uint8_t *)&SPI2->DR = tx;

  /* Wait for RX buffer not empty */
  while (!(SPI2->SR & SPI_SR_RXNE)) {
  }
  return (uint8_t)SPI2->DR;
}

/**
 * @brief  Transfer one 24-bit word (MSB first, three bytes).
 *
 * @param  tx24  Upper 24 bits used; lowest byte ignored.
 * @return Received 24-bit value in bits [23:0] of the returned uint32_t.
 */
static uint32_t spi_xfer_word24(uint32_t tx24) {
  uint32_t rx = 0;
  rx = (uint32_t)spi_xfer_byte((uint8_t)(tx24 >> 16u)) << 16u;
  rx |= (uint32_t)spi_xfer_byte((uint8_t)(tx24 >> 8u)) << 8u;
  rx |= (uint32_t)spi_xfer_byte((uint8_t)(tx24));
  return rx;
}

/* Wait until SPI2 is not busy (BSY cleared) — needed before releasing CS */
static inline void spi_wait_not_busy(void) {
  while (SPI2->SR & SPI_SR_BSY) {
  }
}

/* -------------------------------------------------------------------------
 * ADS131M08 frame-level helpers
 * ------------------------------------------------------------------------- */

/**
 * @brief  Send one complete SPI communication frame.
 *
 * Frame layout (24-bit words, CRC disabled):
 *   Word 0 : command → chip returns STATUS
 *   Words 1-8 : dummy TX 0x000000 → chip returns CH0..CH7 raw data
 *   (Word 9 CRC is not requested, so we stop after 9 words total)
 *
 * @param  dev      Device handle.
 * @param  cmd16    16-bit command word (zero-extended to 24 bits on TX).
 * @param  words    Output array of 9 uint32_t (status + 8 channel words).
 */
static void send_frame(ADS131M08_t *dev, uint16_t cmd16, uint32_t words[9]) {
  cs_low(dev);

  /* Command word occupies the first 16 of 24 bits; last byte = 0 */
  words[0] = spi_xfer_word24((uint32_t)cmd16 << 8u);

  for (uint8_t i = 1u; i < 9u; i++) {
    words[i] = spi_xfer_word24(0u);
  }

  spi_wait_not_busy();
  cs_high(dev);
}

/**
 * @brief  Decode a raw 24-bit unsigned value to a signed 32-bit integer.
 *
 * The ADC output is two's complement, 24-bit.  Sign-extend bit 23.
 */
static int32_t decode24(uint32_t raw) {
  raw &= 0x00FFFFFFu;
  if (raw & 0x00800000u) { /* bit 23 set → negative number */
    return (int32_t)(raw | 0xFF000000u);
  }
  return (int32_t)raw;
}

/* =========================================================================
 * Peripheral initialisation (register-level)
 * ========================================================================= */

/**
 * @brief  Configure TIM2 to output ~8.182 MHz PWM on the CLKIN pin.
 *
 * TIM2 clock = APB1_timer_clock = 2 × APB1 = 2 × 45 MHz = 90 MHz
 * (APB1 prescaler = 4 ≠ 1, so TIMx gets ×2 multiplier per RM0390 §6.2).
 *
 * PSC=0, ARR=10  →  f = 90 MHz / (0+1) / (10+1) ≈ 8.182 MHz
 * CCR = 5        →  duty ≈ 5/11 ≈ 45 % (spec: 40–60 %)
 */
static void tim2_clkin_init(ADS131M08_t *dev) {
  /* --- Enable TIM2 and GPIO clocks --- */
  RCC->APB1ENR |= RCC_APB1ENR_TIM2EN;

  /* Determine which AHB1 GPIO clock to enable from the port pointer */
  if (dev->clkin_port == GPIOA) {
    RCC->AHB1ENR |= RCC_AHB1ENR_GPIOAEN;
  } else if (dev->clkin_port == GPIOB) {
    RCC->AHB1ENR |= RCC_AHB1ENR_GPIOBEN;
  } else if (dev->clkin_port == GPIOC) {
    RCC->AHB1ENR |= RCC_AHB1ENR_GPIOCEN;
  } else if (dev->clkin_port == GPIOD) {
    RCC->AHB1ENR |= RCC_AHB1ENR_GPIODEN;
  }

  /* --- Configure CLKIN pin as AF1 (TIM2), push-pull, high speed --- */
  /* Pin number is a bitmask (e.g. GPIO_PIN_0 = 0x0001); find the bit position
   */
  uint8_t pin_pos = 0u;
  {
    uint16_t mask = dev->clkin_pin;
    while ((mask & 1u) == 0u) {
      mask >>= 1u;
      pin_pos++;
    }
  }

  /* Alternate function register: AFRL covers pins 0-7, AFRH covers 8-15 */
  if (pin_pos < 8u) {
    dev->clkin_port->AFR[0] &= ~(0xFu << (pin_pos * 4u));
    dev->clkin_port->AFR[0] |= (1u << (pin_pos * 4u)); /* AF1 */
  } else {
    uint8_t p = pin_pos - 8u;
    dev->clkin_port->AFR[1] &= ~(0xFu << (p * 4u));
    dev->clkin_port->AFR[1] |= (1u << (p * 4u)); /* AF1 */
  }

  /* Mode = alternate function (10b) */
  dev->clkin_port->MODER &= ~(3u << (pin_pos * 2u));
  dev->clkin_port->MODER |= (2u << (pin_pos * 2u));

  /* Output type = push-pull (0, already default) */
  dev->clkin_port->OTYPER &= ~dev->clkin_pin;

  /* Speed = high (10b) */
  dev->clkin_port->OSPEEDR &= ~(3u << (pin_pos * 2u));
  dev->clkin_port->OSPEEDR |= (2u << (pin_pos * 2u));

  /* No pull */
  dev->clkin_port->PUPDR &= ~(3u << (pin_pos * 2u));

  /* --- TIM2 timer base --- */
  TIM2->CR1 = 0u;         /* disable while configuring */
  TIM2->PSC = 0u;         /* no prescaler */
  TIM2->ARR = 10u;        /* auto-reload: period = 11 TIM clocks */
  TIM2->EGR = TIM_EGR_UG; /* force update to latch PSC and ARR now */

  /* --- Configure the selected output compare channel for PWM mode 1 --- */
  /* PWM mode 1: OC active while CNT < CCR  (bits OC1M = 110) */
  switch (dev->tim2_channel) {
  case 1u:
    TIM2->CCMR1 &= ~(TIM_CCMR1_OC1M | TIM_CCMR1_CC1S);
    TIM2->CCMR1 |= TIM_CCMR1_OC1M_1 | TIM_CCMR1_OC1M_2; /* 110 = PWM1 */
    TIM2->CCMR1 |= TIM_CCMR1_OC1PE;                     /* preload enable */
    TIM2->CCR1 = 5u;
    TIM2->CCER |= TIM_CCER_CC1E;
    break;
  case 2u:
    TIM2->CCMR1 &= ~(TIM_CCMR1_OC2M | TIM_CCMR1_CC2S);
    TIM2->CCMR1 |= TIM_CCMR1_OC2M_1 | TIM_CCMR1_OC2M_2;
    TIM2->CCMR1 |= TIM_CCMR1_OC2PE;
    TIM2->CCR2 = 5u;
    TIM2->CCER |= TIM_CCER_CC2E;
    break;
  case 3u:
    TIM2->CCMR2 &= ~(TIM_CCMR2_OC3M | TIM_CCMR2_CC3S);
    TIM2->CCMR2 |= TIM_CCMR2_OC3M_1 | TIM_CCMR2_OC3M_2;
    TIM2->CCMR2 |= TIM_CCMR2_OC3PE;
    TIM2->CCR3 = 5u;
    TIM2->CCER |= TIM_CCER_CC3E;
    break;
  case 4u:
  default:
    TIM2->CCMR2 &= ~(TIM_CCMR2_OC4M | TIM_CCMR2_CC4S);
    TIM2->CCMR2 |= TIM_CCMR2_OC4M_1 | TIM_CCMR2_OC4M_2;
    TIM2->CCMR2 |= TIM_CCMR2_OC4PE;
    TIM2->CCR4 = 5u;
    TIM2->CCER |= TIM_CCER_CC4E;
    break;
  }

  /* Start the counter — CLKIN begins toggling immediately */
  TIM2->CR1 = TIM_CR1_CEN;
}

/**
 * @brief  Configure SPI2 for ADS131M08 communication.
 *
 * Fixed pins (AF5):
 *   PB13 — SCK   push-pull
 *   PB14 — MISO  floating input (chip drives it)
 *   PB15 — MOSI  push-pull
 *
 * Rate: APB1(45 MHz) / 8 = 5.625 MHz  (tSCLK ≈ 178 ns >> 98 ns minimum)
 * Mode: CPOL=0, CPHA=1  →  SPI Mode 1  (data captured on second edge)
 */
static void spi2_init(void) {
  /* Enable clocks for SPI2 and GPIOB */
  RCC->APB1ENR |= RCC_APB1ENR_SPI2EN;
  RCC->AHB1ENR |= RCC_AHB1ENR_GPIOBEN;

  /* --- PB13 SCK: AF5, output push-pull, high speed --- */
  GPIOB->AFR[1] &= ~(0xFu << ((13u - 8u) * 4u));
  GPIOB->AFR[1] |= (5u << ((13u - 8u) * 4u));
  GPIOB->MODER &= ~(3u << (13u * 2u));
  GPIOB->MODER |= (2u << (13u * 2u));   /* AF mode */
  GPIOB->OSPEEDR |= (3u << (13u * 2u)); /* very high speed */
  GPIOB->OTYPER &= ~GPIO_ODR_OD13;      /* push-pull */

  /* --- PB14 MISO: AF5, input (floating — chip is the driver) --- */
  GPIOB->AFR[1] &= ~(0xFu << ((14u - 8u) * 4u));
  GPIOB->AFR[1] |= (5u << ((14u - 8u) * 4u));
  GPIOB->MODER &= ~(3u << (14u * 2u));
  GPIOB->MODER |= (2u << (14u * 2u));
  GPIOB->PUPDR &= ~(3u << (14u * 2u)); /* no pull */

  /* --- PB15 MOSI: AF5, output push-pull, high speed --- */
  GPIOB->AFR[1] &= ~(0xFu << ((15u - 8u) * 4u));
  GPIOB->AFR[1] |= (5u << ((15u - 8u) * 4u));
  GPIOB->MODER &= ~(3u << (15u * 2u));
  GPIOB->MODER |= (2u << (15u * 2u));
  GPIOB->OSPEEDR |= (3u << (15u * 2u));
  GPIOB->OTYPER &= ~GPIO_ODR_OD15;

  /* --- SPI2 control registers ---
   * CR1:
   *   MSTR  = 1  — master mode
   *   BR    = 010 — fPCLK/8 = 5.625 MHz
   *   CPHA  = 1  — second clock edge captures data (Mode 1)
   *   CPOL  = 0  — clock idles low
   *   SSM   = 1  — software NSS management
   *   SSI   = 1  — internal NSS high (prevents MODF fault)
   *   DFF   = 0  — 8-bit frame format
   *   LSBFIRST = 0 — MSB first
   */
  SPI2->CR1 = SPI_CR1_MSTR | (2u << SPI_CR1_BR_Pos) /* BR[2:0] = 010 → /8 */
              | SPI_CR1_CPHA | SPI_CR1_SSM | SPI_CR1_SSI;

  SPI2->CR2 = 0u; /* 8-bit, no interrupts, no DMA */

  SPI2->CR1 |= SPI_CR1_SPE; /* enable SPI2 */
}

/**
 * @brief  Configure a GPIO pin as push-pull output and set its initial state.
 */
static void gpio_output_init(GPIO_TypeDef *port, uint16_t pin,
                             uint8_t initial_state) {
  /* Enable the clock for the relevant GPIO port */
  if (port == GPIOA) {
    RCC->AHB1ENR |= RCC_AHB1ENR_GPIOAEN;
  } else if (port == GPIOB) {
    RCC->AHB1ENR |= RCC_AHB1ENR_GPIOBEN;
  } else if (port == GPIOC) {
    RCC->AHB1ENR |= RCC_AHB1ENR_GPIOCEN;
  } else if (port == GPIOD) {
    RCC->AHB1ENR |= RCC_AHB1ENR_GPIODEN;
  }

  uint8_t pin_pos = 0u;
  uint16_t mask = pin;
  while ((mask & 1u) == 0u) {
    mask >>= 1u;
    pin_pos++;
  }

  /* Set initial output level before enabling output to avoid glitch */
  if (initial_state) {
    port->BSRR = pin; /* set high */
  } else {
    port->BSRR = (uint32_t)pin << 16u; /* set low */
  }

  port->MODER &= ~(3u << (pin_pos * 2u));
  port->MODER |= (1u << (pin_pos * 2u));   /* general-purpose output */
  port->OTYPER &= ~pin;                    /* push-pull */
  port->OSPEEDR |= (2u << (pin_pos * 2u)); /* high speed */
  port->PUPDR &= ~(3u << (pin_pos * 2u));  /* no pull */
}

/**
 * @brief  Configure a GPIO pin as input with pull-up.
 */
static void gpio_input_pullup_init(GPIO_TypeDef *port, uint16_t pin) {
  if (port == GPIOA) {
    RCC->AHB1ENR |= RCC_AHB1ENR_GPIOAEN;
  } else if (port == GPIOB) {
    RCC->AHB1ENR |= RCC_AHB1ENR_GPIOBEN;
  } else if (port == GPIOC) {
    RCC->AHB1ENR |= RCC_AHB1ENR_GPIOCEN;
  } else if (port == GPIOD) {
    RCC->AHB1ENR |= RCC_AHB1ENR_GPIODEN;
  }

  uint8_t pin_pos = 0u;
  uint16_t mask = pin;
  while ((mask & 1u) == 0u) {
    mask >>= 1u;
    pin_pos++;
  }

  port->MODER &= ~(3u << (pin_pos * 2u)); /* input mode (00) */
  port->PUPDR &= ~(3u << (pin_pos * 2u));
  port->PUPDR |= (1u << (pin_pos * 2u)); /* pull-up */
}

/* =========================================================================
 * Blocking DRDY wait
 * ========================================================================= */

/**
 * @brief  Block until DRDY goes low (new conversion data ready) or timeout.
 *
 * DRDY is normally high and pulses low when the chip finishes a conversion.
 */
static HAL_StatusTypeDef wait_drdy(const ADS131M08_t *dev) {
  uint32_t t0 = HAL_GetTick();
  while (drdy_is_high(dev)) {
    if ((HAL_GetTick() - t0) >= DRDY_TIMEOUT_MS) {
      return HAL_TIMEOUT;
    }
  }
  return HAL_OK;
}

/* =========================================================================
 * GAIN register helpers
 * ========================================================================= */

/**
 * @brief  Build the 16-bit value for GAIN1 or GAIN2 register from dev->gain[].
 *
 * GAIN1 controls ch0..ch3 (4 bits each, ch0 in bits [3:0]).
 * GAIN2 controls ch4..ch7.
 */
static uint16_t build_gain_reg(const ADS131M08_t *dev, uint8_t reg_index) {
  uint16_t val = 0u;
  uint8_t base = reg_index * 4u; /* 0 for GAIN1, 4 for GAIN2 */
  for (uint8_t i = 0u; i < 4u; i++) {
    val |= (uint16_t)((dev->gain[base + i] & 0x7u) << (i * 4u));
  }
  return val;
}

/* =========================================================================
 * Public API implementation
 * ========================================================================= */

HAL_StatusTypeDef ADS131M08_Init(ADS131M08_t *dev) {
  dev->initialized = 0u;

  /* 1. Start CLKIN immediately — the chip needs a clock from power-up */
  tim2_clkin_init(dev);

  /* 2. SPI2 */
  spi2_init();

  /* 3. Control GPIOs
   *    CS   — output, start HIGH (deselected)
   *    RST  — output, start HIGH (not in reset)
   *    DRDY — input with pull-up (chip drives it low when data is ready) */
  gpio_output_init(dev->cs_port, dev->cs_pin, 1u);
  gpio_output_init(dev->rst_port, dev->rst_pin, 1u);
  gpio_input_pullup_init(dev->drdy_port, dev->drdy_pin);

  /* 4. Hardware + software reset; waits for DRDY */
  if (ADS131M08_Reset(dev) != HAL_OK) {
    return HAL_ERROR;
  }

  /* 5. Verify device ID — upper byte must be 0x28 for ADS131M08 */
  uint16_t id = ADS131M08_ReadReg(dev, ADS131M08_REG_ID);
  if ((id >> 8u) != ADS131M08_ID_UPPER) {
    return HAL_ERROR;
  }

  /* 6. Program CLOCK register (OSR, power mode, channel enable) */
  ADS131M08_WriteReg(dev, ADS131M08_REG_CLOCK, dev->clock_reg);

  /* 7. Program per-channel gain */
  ADS131M08_WriteReg(dev, ADS131M08_REG_GAIN1, build_gain_reg(dev, 0u));
  ADS131M08_WriteReg(dev, ADS131M08_REG_GAIN2, build_gain_reg(dev, 1u));

  dev->initialized = 1u;
  return HAL_OK;
}

HAL_StatusTypeDef ADS131M08_Reset(ADS131M08_t *dev) {
  /* Hardware reset: hold RST low for at least 2 µs (2048 ns per datasheet) */
  rst_low(dev);
  HAL_Delay(1u); /* 1 ms >> 2 µs */
  rst_high(dev);

  /* Wait for DRDY to go low — chip signals it is ready after reset */
  if (wait_drdy(dev) != HAL_OK) {
    return HAL_TIMEOUT;
  }

  /* Send SPI RESET command to reinitialise digital filter state */
  uint32_t dummy[9];
  send_frame(dev, ADS131M08_CMD_RESET, dummy);

  /* Wait again: the chip restarts its filter pipeline after the command */
  if (wait_drdy(dev) != HAL_OK) {
    return HAL_TIMEOUT;
  }

  return HAL_OK;
}

bool ADS131M08_WriteReg(ADS131M08_t *dev, uint8_t addr, uint16_t data) {
  uint32_t resp[9];

  /* Frame 1: send WREG command + register data in second word.
   * The WREG frame: [WREG cmd] [data word] [0x00 × 7 padding]
   * We send it manually (not via send_frame) to include the data word. */
  cs_low(dev);
  spi_xfer_word24((uint32_t)ADS131M08_CMD_WREG(addr) << 8u);
  spi_xfer_word24((uint32_t)data << 8u);
  for (uint8_t i = 0u; i < 7u; i++) {
    spi_xfer_word24(0u);
  }
  spi_wait_not_busy();
  cs_high(dev);

  /* Frame 2: null command — the chip echoes the WREG acknowledgement
   * in the STATUS word of the NEXT frame */
  send_frame(dev, ADS131M08_CMD_NULL, resp);

  /* Check: STATUS[15:0] should match the expected WREG echo pattern */
  uint16_t status16 = (uint16_t)(resp[0] >> 8u); /* upper 16 of 24-bit word */
  return (status16 == ADS131M08_RESP_WREG(addr));
}

uint16_t ADS131M08_ReadReg(ADS131M08_t *dev, uint8_t addr) {
  uint32_t resp[9];

  /* Frame 1: send RREG command */
  send_frame(dev, ADS131M08_CMD_RREG(addr), resp);

  /* Frame 2: null command — chip returns the register value in word[0] */
  send_frame(dev, ADS131M08_CMD_NULL, resp);

  /* The register value occupies the upper 16 bits of the 24-bit response word
   */
  return (uint16_t)(resp[0] >> 8u);
}

HAL_StatusTypeDef ADS131M08_ReadData(ADS131M08_t *dev, int32_t out[8]) {
  /* Block until DRDY asserts (chip has a fresh conversion set) */
  if (wait_drdy(dev) != HAL_OK) {
    return HAL_TIMEOUT;
  }

  uint32_t raw[9];
  send_frame(dev, ADS131M08_CMD_NULL, raw);

  /* raw[0] = STATUS word; raw[1..8] = CH0..CH7 */
  for (uint8_t i = 0u; i < 8u; i++) {
    out[i] = decode24(raw[i + 1u]);
  }
  return HAL_OK;
}

void ADS131M08_SetChannelMux(ADS131M08_t *dev, uint8_t ch, uint8_t mux) {
  if (ch > 7u)
    return;

  uint8_t reg_addr = ADS131M08_REG_CHx_CFG(ch);
  uint16_t current = ADS131M08_ReadReg(dev, reg_addr);

  /* Replace MUX[1:0] (bits 1:0) with the new value */
  current = (current & ~0x3u) | (mux & 0x3u);
  ADS131M08_WriteReg(dev, reg_addr, current);
}

void ADS131M08_SetGain(ADS131M08_t *dev, uint8_t ch, uint8_t gain) {
  if (ch > 7u)
    return;

  dev->gain[ch] = gain & 0x7u;

  /* Determine whether this channel lives in GAIN1 (ch 0-3) or GAIN2 (ch 4-7) */
  uint8_t reg_idx = ch / 4u; /* 0 = GAIN1, 1 = GAIN2 */
  uint8_t reg_addr = ADS131M08_REG_GAIN1 + reg_idx;
  ADS131M08_WriteReg(dev, reg_addr, build_gain_reg(dev, reg_idx));
}

void ADS131M08_Standby(ADS131M08_t *dev) {
  uint32_t dummy[9];
  send_frame(dev, ADS131M08_CMD_STANDBY, dummy);
}

void ADS131M08_Wakeup(ADS131M08_t *dev) {
  uint32_t dummy[9];
  send_frame(dev, ADS131M08_CMD_WAKEUP, dummy);
  /* Give the filter pipeline time to re-settle (~1 conversion cycle) */
  HAL_Delay(1u);
}

float ADS131M08_ToMillivolts(int32_t code, uint8_t gain_lin) {
  /* V = code × Vref / (2^23 × gain)
   * 2^23 = 8388608  — positive full-scale code for internal 1.2 V ref */
  if (gain_lin == 0u)
    gain_lin = 1u;
  return ((float)code * ADS131M08_VREF_INT_MV) / (8388608.0f * (float)gain_lin);
}

/* =========================================================================
 * Calibration — internal helpers
 * ========================================================================= */

/**
 * @brief  Write a 24-bit calibration value to a pair of adjacent 16-bit
 *         registers (MSB then LSB layout used by OCAL and GCAL).
 *
 * Register layout (per datasheet):
 *   MSB register: val[23:8]        stored as-is in bits [15:0]
 *   LSB register: val[7:0]         stored in bits [15:8], bits [7:0] = 0
 */
static void write_cal_reg24(ADS131M08_t *dev, uint8_t msb_addr,
                            uint8_t lsb_addr, uint32_t val24) {
  ADS131M08_WriteReg(dev, msb_addr, (uint16_t)((val24 >> 8u) & 0xFFFFu));
  ADS131M08_WriteReg(dev, lsb_addr, (uint16_t)((val24 & 0xFFu) << 8u));
}

/**
 * @brief  Read CAL_FRAMES conversion frames and return the average for one
 *         channel.  Assumes the MUX is already set to the desired source.
 *
 * A short settling delay must be inserted by the caller before this function.
 */
static int32_t cal_average(ADS131M08_t *dev, uint8_t ch) {
  int64_t acc = 0;
  int32_t frame[8];
  uint8_t valid = 0u;

  for (uint8_t f = 0u; f < ADS131M08_CAL_FRAMES; f++) {
    if (ADS131M08_ReadData(dev, frame) == HAL_OK) {
      acc += frame[ch];
      valid++;
    }
  }
  if (valid == 0u)
    return 0;
  return (int32_t)(acc / (int64_t)valid);
}

/* =========================================================================
 * Calibration — public API
 * ========================================================================= */

HAL_StatusTypeDef ADS131M08_CalibrateOffset(ADS131M08_t *dev, uint8_t ch) {
  if (ch > 7u)
    return HAL_ERROR;

  uint8_t reg_addr = ADS131M08_REG_CHx_CFG(ch);

  /* Save the current channel configuration (MUX and DC-block settings) */
  uint16_t saved_cfg = ADS131M08_ReadReg(dev, reg_addr);

  /* Route input to internal AGND short — no external wiring change needed */
  ADS131M08_SetChannelMux(dev, ch, ADS131M08_MUX_SHORTED);

  /* Wait for the sinc³ filter to fully settle after the MUX switch.
   * Worst-case settling at OSR 16384 ≈ 33368 / 8.182 MHz ≈ 4.1 ms; 10 ms
   * covers all OSR settings with margin. */
  HAL_Delay(10u);

  /* Discard the first frame — it may contain pre-switch data */
  int32_t dummy[8];
  if (ADS131M08_ReadData(dev, dummy) != HAL_OK) {
    ADS131M08_WriteReg(dev, reg_addr, saved_cfg);
    return HAL_TIMEOUT;
  }

  /* Average CAL_FRAMES frames → offset code (signed 24-bit, two's complement)
   */
  int32_t offset_code = cal_average(dev, ch);
  if (offset_code == 0 && ADS131M08_ReadData(dev, dummy) != HAL_OK) {
    /* cal_average timed out on every frame */
    ADS131M08_WriteReg(dev, reg_addr, saved_cfg);
    return HAL_TIMEOUT;
  }

  /* Write offset to OCAL registers.
   * The chip computes: output = (raw - OCAL) × GCAL / 2²³
   * So writing OCAL = measured_offset cancels the zero error. */
  write_cal_reg24(dev, ADS131M08_REG_CHx_OCAL_MSB(ch),
                  ADS131M08_REG_CHx_OCAL_LSB(ch),
                  (uint32_t)offset_code & 0x00FFFFFFu);

  /* Restore original MUX / channel config */
  ADS131M08_WriteReg(dev, reg_addr, saved_cfg);

  return HAL_OK;
}

HAL_StatusTypeDef ADS131M08_CalibrateGain(ADS131M08_t *dev, uint8_t ch) {
  if (ch > 7u)
    return HAL_ERROR;

  uint8_t reg_addr = ADS131M08_REG_CHx_CFG(ch);

  /* Save current channel config */
  uint16_t saved_cfg = ADS131M08_ReadReg(dev, reg_addr);

  /* Reset GCAL to unity (0x800000) so we calibrate from a clean baseline,
   * not on top of a previous (possibly wrong) correction. */
  write_cal_reg24(dev, ADS131M08_REG_CHx_GCAL_MSB(ch),
                  ADS131M08_REG_CHx_GCAL_LSB(ch), 0x800000u);

  /* Route input to internal positive DC test signal.
   * Per §8.3.9: V_test = 2/15 × V_REF, auto-scaled by 1/gain so the
   * ideal output code is gain-independent:
   *   ideal_code = round(2/15 × 2²³) = 1 118 481 */
  ADS131M08_SetChannelMux(dev, ch, ADS131M08_MUX_POSITIVE_DC);
  HAL_Delay(10u);

  /* Discard first frame after MUX change */
  int32_t dummy[8];
  if (ADS131M08_ReadData(dev, dummy) != HAL_OK) {
    ADS131M08_WriteReg(dev, reg_addr, saved_cfg);
    return HAL_TIMEOUT;
  }

  int32_t measured = cal_average(dev, ch);

  /* Sanity check: a zero or negative reading means something is wrong
   * (chip not connected, offset larger than the test signal, etc.) */
  if (measured <= 0) {
    ADS131M08_WriteReg(dev, reg_addr, saved_cfg);
    return HAL_ERROR;
  }

  /* Compute GCAL:
   *   output = raw × GCAL / 2²³  (after offset has been applied by OCAL)
   *   We want output = ideal_code when raw = measured:
   *   GCAL = ideal_code × 2²³ / measured
   *
   * Use uint64_t to avoid overflow: 1118481 × 8388608 ≈ 9.38 × 10¹² */
  const uint32_t ideal_code = 1118481u; /* round(2/15 × 2^23) */
  uint32_t gcal = (uint32_t)(((uint64_t)ideal_code * (uint64_t)0x800000u) /
                             (uint64_t)measured);

  /* Clamp to the maximum representable value (just under ×2) */
  if (gcal > 0xFFFFFFu)
    gcal = 0xFFFFFFu;

  write_cal_reg24(dev, ADS131M08_REG_CHx_GCAL_MSB(ch),
                  ADS131M08_REG_CHx_GCAL_LSB(ch), gcal);

  /* Restore original channel config */
  ADS131M08_WriteReg(dev, reg_addr, saved_cfg);

  return HAL_OK;
}

HAL_StatusTypeDef ADS131M08_CalibrateAll(ADS131M08_t *dev) {
  /* Offset first on all channels, then gain — matches the hardware pipeline
   * order: output = (raw - OCAL) × GCAL / 2²³  */
  for (uint8_t ch = 0u; ch < 8u; ch++) {
    HAL_StatusTypeDef r = ADS131M08_CalibrateOffset(dev, ch);
    if (r != HAL_OK)
      return r;
  }
  for (uint8_t ch = 0u; ch < 8u; ch++) {
    HAL_StatusTypeDef r = ADS131M08_CalibrateGain(dev, ch);
    if (r != HAL_OK)
      return r;
  }
  return HAL_OK;
}
